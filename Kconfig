## osdrv/platform/liteos/compat/linux/Kconfig
```kconfig
config  LOSCFG_COMPAT_LINUX
    bool "Enable Linux"
    default y

    help
      Answer Y to enable LiteOS support linux interface.
```

## osdrv/platform/liteos/drivers/base/Kconfig
```kconfig
config LOSCFG_DRIVERS_BASE
    bool "Enable Driver Base"
    default y
    depends on LOSCFG_DRIVERS
    help
      Answer Y to enable LiteOS to support driver base
```

## osdrv/platform/liteos/drivers/cpufreq/Kconfig
```kconfig
config LOSCFG_DRIVERS_CPUFREQ
    bool "Enable CpuFreq"
    default y
    depends on LOSCFG_DRIVERS
    help
      Answer Y to enable LiteOS to support CpuFreq
```

## osdrv/platform/liteos/drivers/devfreq/Kconfig
```kconfig
config LOSCFG_DRIVERS_DEVFREQ
    bool "Enable DevFreq"
    default y
    depends on LOSCFG_DRIVERS
    help
      Answer Y to enable LiteOS to support DevFreq
```

## osdrv/platform/liteos/drivers/gpio/Kconfig
```kconfig
config LOSCFG_DRIVERS_GPIO
    bool "Enable GPIO"
    default y
    depends on LOSCFG_DRIVERS && LOSCFG_FS_VFS
    help
      Answer Y to enable LiteOS support gpio.
```

## osdrv/platform/liteos/drivers/hidmac/Kconfig
```kconfig
config LOSCFG_DRIVERS_HIDMAC
    bool "Enable HIDMAC"
    default y
    depends on LOSCFG_DRIVERS
    help
      Answer Y to enable LiteOS support hidmac.
```

## osdrv/platform/liteos/drivers/hiedmac/Kconfig
```kconfig
config LOSCFG_DRIVERS_HIEDMAC
    bool "Enable HIEDMAC"
    default n
    depends on LOSCFG_DRIVERS && LOSCFG_PLATFORM_HI3559AV100
    help
      Answer Y to enable LiteOS support hiedmac.
```

## osdrv/platform/liteos/drivers/hieth-sf/Kconfig
```kconfig
config LOSCFG_DRIVERS_HIETH_SF
    bool "Enable hieth-sf"
    depends on LOSCFG_DRIVERS_NETDEV && (LOSCFG_PLATFORM_HI3518EV200 || LOSCFG_PLATFORM_HI3911 || LOSCFG_PLATFORM_HIM5V100 || LOSCFG_PLATFORM_HI3731  || LOSCFG_PLATFORM_HI3516CV300 || LOSCFG_PLATFORM_HI3516CV500 || LOSCFG_PLATFORM_HI3516DV300 || LOSCFG_PLATFORM_HI3516EV200 || LOSCFG_PLATFORM_HI3559V200)
```

## osdrv/platform/liteos/drivers/higmac/Kconfig
```kconfig
config LOSCFG_DRIVERS_HIGMAC
    bool "Enable higmac"
    depends on LOSCFG_DRIVERS_NETDEV && (LOSCFG_PLATFORM_HI3516A || LOSCFG_PLATFORM_HI3519 || LOSCFG_PLATFORM_HI3519V101 || LOSCFG_PLATFORM_HI3559 || LOSCFG_PLATFORM_HI3559AV100ES || LOSCFG_PLATFORM_HI3559AV100)
```

## osdrv/platform/liteos/drivers/i2c/Kconfig
```kconfig
config LOSCFG_DRIVERS_I2C
    bool "Enable I2C"
    default y
    depends on LOSCFG_DRIVERS
    help
      Answer Y to enable LiteOS support i2c.
config LOSCFG_I2C_ADAPTER_COUNT
    int "Number of i2c adapter count"
    depends on LOSCFG_DRIVERS_I2C
    range 0 128
    default 4
    help
      I2c adatper count, range from 0 to 128.
config LOSCFG_HOST_TYPE_HIBVT
    bool "i2c host type is hibvt"
    default y
    depends on LOSCFG_DRIVERS && (LOSCFG_PLATFORM_HI3559AV100ES || LOSCFG_PLATFORM_HI3516CV300 || LOSCFG_PLATFORM_HI3559AV100 || LOSCFG_PLATFORM_HI3556AV100 || LOSCFG_PLATFORM_HI3519AV100 || LOSCFG_PLATFORM_HI3516CV500 || LOSCFG_PLATFORM_HI3516DV300 || LOSCFG_PLATFORM_HI3556V200  || LOSCFG_PLATFORM_HI3559V200 || LOSCFG_PLATFORM_HI3516EV200)
    help
      i2c host type is hibvt.
```

## osdrv/platform/liteos/drivers/mem/Kconfig
```kconfig
config LOSCFG_DRIVERS_MEM
    bool "Enable MEM"
    default y
    depends on LOSCFG_DRIVERS && LOSCFG_FS_VFS
    help
      Answer Y to enable LiteOS support mem.
```

## osdrv/platform/liteos/drivers/mmc/Kconfig
```kconfig
config LOSCFG_DRIVERS_MMC
    depends on LOSCFG_DRIVERS
    bool "Enable MMC"
    default y
    depends on LOSCFG_DRIVERS && LOSCFG_FS_VFS
    help
      Answer Y to enable LiteOS support MMC driver.
choice
    depends on LOSCFG_DRIVERS_MMC && LOSCFG_PLATFORM_HI3518EV200
    prompt " MMC0 support device type"
    default LOSCFG_DRIVERS_SD
    help
      Enable LiteOS MMC driver support SD card.
      Enable LiteOS MMC driver support eMMC.

config LOSCFG_DRIVERS_SD
    bool "Enable MMC0 support SD card type"

config LOSCFG_DRIVERS_EMMC
    bool "Enable MMC0 support eMMC type"

endchoice

config LOSCFG_DRIVERS_MMC_SPEEDUP
    depends on LOSCFG_DRIVERS_MMC && (LOSCFG_PLATFORM_HI3519 || LOSCFG_PLATFORM_HI3519V101 || LOSCFG_PLATFORM_HI3559)
    bool "Enable MMC support speedup"
    default n
    help
      Answer Y to enable LiteOS support speedup.
```

## osdrv/platform/liteos/drivers/mtd/nand/Kconfig
```kconfig
config LOSCFG_DRIVERS_MTD_NAND
    bool "Enable MTD nandflash"
    default y
    depends on LOSCFG_DRIVERS_MTD
    help
      Answer Y to support nandflash.

choice
    depends    on LOSCFG_DRIVERS_MTD_NAND
    prompt "NandFlash Chips"
    default LOSCFG_DRIVERS_MTD_NAND_HINFC620

config LOSCFG_DRIVERS_MTD_NAND_HINFC620
    depends on LOSCFG_PLATFORM_HI3516A
    bool "Enable hinfc620 for parallel nand"
    help
      Answer Y to support hinfc620.

config LOSCFG_DRIVERS_MTD_NAND_HISNFC100
    depends on LOSCFG_PLATFORM_HI3516A
    bool "Enable hisnfc100 for spi nand"
    help
      Answer Y to support hisnfc100.

config LOSCFG_DRIVERS_MTD_NAND_HIFMC100
    depends on LOSCFG_PLATFORM_HI3518EV200 || LOSCFG_PLATFORM_HI3519 || LOSCFG_PLATFORM_HI3519V101 || LOSCFG_PLATFORM_HI3559 || LOSCFG_PLATFORM_HI3516CV300 || LOSCFG_PLATFORM_HI3559AV100ES || LOSCFG_PLATFORM_HI3516EV200
    bool "Enable hifmc100 for spi nand"
    help
      Answer Y to support hifmc100.

config LOSCFG_DRIVERS_MTD_NAND_HIFMC100_PARALLEL
    depends on LOSCFG_PLATFORM_HI3519 || LOSCFG_PLATFORM_HI3519V101 || LOSCFG_PLATFORM_HI3559 || LOSCFG_PLATFORM_HI3559AV100ES
    bool "Enable hifmc100 for parallel nand"
    help
      Answer Y to support hifmc100.
endchoice
```

## osdrv/platform/liteos/drivers/mtd/spi_nor/Kconfig
```kconfig
config LOSCFG_DRIVERS_MTD_SPI_NOR
    bool "Enable MTD spi_nor flash"
    default y
    depends on LOSCFG_DRIVERS_MTD
    help
      Answer Y to support spi_nor flash.
choice
    depends on  LOSCFG_DRIVERS_MTD_SPI_NOR
    prompt "SpiNorFlash Chips"
    default LOSCFG_DRIVERS_MTD_SPI_NOR_HISFC350

config LOSCFG_DRIVERS_MTD_SPI_NOR_HISFC350
    depends on LOSCFG_PLATFORM_HI3516A || LOSCFG_PLATFORM_HI3731
    bool "Enable hisfc350"
    help
      Answer Y to support hisfc350.

config LOSCFG_DRIVERS_MTD_SPI_NOR_HIFMC100
    depends on LOSCFG_PLATFORM_HI3518EV200 || LOSCFG_PLATFORM_HI3519 || LOSCFG_PLATFORM_HI3519V101 || LOSCFG_PLATFORM_HI3559  || LOSCFG_PLATFORM_HI3516CV300 || LOSCFG_PLATFORM_HI3559AV100ES || LOSCFG_PLATFORM_HI3559AV100 || LOSCFG_PLATFORM_HI3516CV500 || LOSCFG_PLATFORM_HI3516DV300 || LOSCFG_PLATFORM_HI3516EV200
    bool "Enable hifmc100"
    help
      Answer Y to support hifmc100.
endchoice
```

## osdrv/platform/liteos/drivers/random/Kconfig
```kconfig
config LOSCFG_DRIVERS_RANDOM
    bool "Enable random"
    default y
    depends on LOSCFG_DRIVERS && LOSCFG_FS_VFS
    help
        Answer Y to support random.
config LOSCFG_HW_RANDOM_ENABLE
    depends on LOSCFG_DRIVERS_RANDOM && (LOSCFG_PLATFORM_HI3518EV200 || LOSCFG_PLATFORM_HI3516CV300)
    bool "Select hw random"
    default y
    help
    Answer Y to select hw random.
```

## osdrv/platform/liteos/drivers/regulator/Kconfig
```kconfig
config LOSCFG_DRIVERS_REGULATOR
    bool "Enable Regulator"
    default y
    depends on LOSCFG_DRIVERS
    help
      Answer Y to enable LiteOS to support Regulator
```

## osdrv/platform/liteos/drivers/rtc/Kconfig
```kconfig
config LOSCFG_DRIVERS_RTC
    bool "Enable RTC"
    default y
    depends on LOSCFG_DRIVERS && LOSCFG_FS_VFS
    help
      Answer Y to enable LiteOS support rtc.
```

## osdrv/platform/liteos/drivers/spi/Kconfig
```kconfig
config LOSCFG_DRIVERS_SPI
    bool "Enable SPI"
    default y
    depends on LOSCFG_DRIVERS && LOSCFG_FS_VFS
    help
      Answer Y to enable LiteOS support spi.

config LOSCFG_DRIVERS_SPI_DMA
    bool "Spi dma mode"
    default n
    depends on LOSCFG_DRIVERS_SPI && LOSCFG_DRIVERS_HIEDMAC
    help
      Answer Y to enable spi dma mode for transfer.
```

## osdrv/platform/liteos/drivers/uart/Kconfig
```kconfig
config LOSCFG_DRIVERS_UART
    bool "General Uart"

    help
      Answer Y to enable LiteOS support uart with vfs.
```
