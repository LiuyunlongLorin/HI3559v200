## reference/common/rawcap/Kconfig
```kconfig
#
# For a description of the syntax of this configuration file,
# see Documentation/kbuild/kconfig-language.txt.
#

#comment "Raw Debug Select"

menu "RawDebug Configuration"
config RAWDEBUG
    bool "RawDebug support"
endmenu
```

## reference/common/recordmng/Kconfig
```kconfig
#
# For a description of the syntax of this configuration file,
# see Documentation/kbuild/kconfig-language.txt.
#

menu "Record Manager Configuration"
choice
	prompt "Record Format"
	config MP4
		bool "MP4"
	config TS
		bool "TS"
endchoice
config SUPPORT_ASYNC_STOP
		bool "Support Async Stop"
endmenu
```

## reference/common/system/Kconfig
```kconfig
#
# For a description of the syntax of this configuration file,
# see Documentation/kbuild/kconfig-language.txt.
#

menu "System Configuration"
config BOOT_LOGO
	bool "BOOT_LOGO support"
	depends on !(DASHCAM && NONESCREEN)
config BOOT_SOUND
	bool "BOOT_SOUND support"
endmenu
```

## reference/common/videodetect/Kconfig
```kconfig
#
# For a description of the syntax of this configuration file,
# see Documentation/kbuild/kconfig-language.txt.
#

menu "Video Detect Configuration"
config VIDEO_DETECT
	bool "VIDEO_DETECT support"
	if VIDEO_DETECT	
		config MOTIONDETECT
		bool "MOTIONDETECT support"
    endif
endmenu
```

## reference/hal/Kconfig
```kconfig
#
# For a description of the syntax of this configuration file,
# see build/scripts/Documentation/kbuild/kconfig-language.txt.
#

menu "Peripheral"

source reference/hal/common/Kconfig
source reference/hal/wifi/Kconfig
source reference/hal/gauge/Kconfig
source reference/hal/screen/Kconfig
source reference/hal/touchpad/Kconfig
source reference/hal/gsensor/Kconfig
source reference/hal/ahd/Kconfig
source reference/hal/led/Kconfig
source reference/hal/motionsensor/Kconfig
source reference/hal/watchdog/Kconfig
source reference/hal/gps/Kconfig
source reference/hal/acc/Kconfig

endmenu
```

## reference/hal/ahd/Kconfig
```kconfig
#
# For a description of the syntax of this configuration file,
# see Documentation/kbuild/kconfig-language.txt.
#
#comment "Device Configuration"

menuconfig AHD
	bool "AHD support"

if AHD
	choice
		prompt "AHD Type"
		config AHD_N3
			bool "N3"
	endchoice
endif
```

## reference/hal/common/Kconfig
```kconfig
#
# For a description of the syntax of this configuration file,
# see Documentation/kbuild/kconfig-language.txt.
#
#comment "ADC Configuration"

menuconfig ADC
	bool "ADC support"
        depends on (HI3559V200 || HI3556V200 || HI3518EV300)
```

## reference/hal/gauge/Kconfig
```kconfig
#
# For a description of the syntax of this configuration file,
# see Documentation/kbuild/kconfig-language.txt.
#
#comment "Device Configuration"

menuconfig GAUGE
	bool "GAUGE support"

if GAUGE
	choice
		prompt "GAUGE Type"
		config GAUGE_BQ27421
			bool "bq27421"
			depends on (HI3556AV100 && CONFIG_REFB_ACTIONCAM)
		if ADC	
	    config GAUGE_ADC
			bool "GAUGE_ADC"
	    endif
	endchoice
endif
```

## reference/hal/gps/Kconfig
```kconfig
#
# For a description of the syntax of this configuration file,
# see Documentation/kbuild/kconfig-language.txt.
#
#comment "Device Configuration"

menuconfig GPS
	bool "GPS support"

	if GPS
	choice
		prompt "GPS Type"
		config GPS_TYPE_M8030
			bool "gps"
			depends on (HI3559V200 || HI3556V200)
		config GPS_TYPE_DUMMY
			bool "dummy"
			depends on (HI3559V200 || HI3556V200)
	endchoice
endif
```

## reference/hal/gsensor/Kconfig
```kconfig
#
# For a description of the syntax of this configuration file,
# see Documentation/kbuild/kconfig-language.txt.
#
#comment "Device Configuration"

menuconfig GSENSOR
	bool "GSENSOR support"

if GSENSOR
	choice
		prompt "GSENSOR Type"
		config GSENSOR_MC3416
			bool "MC3416"
			depends on !HI3559AV100
	endchoice
endif
```

## reference/hal/motionsensor/Kconfig
```kconfig
#
# For a description of the syntax of this configuration file,
# see Documentation/kbuild/kconfig-language.txt.
#
#comment "Device Configuration"

menuconfig MOTIONSENSOR
	bool "MOTIONSENSOR support"

if MOTIONSENSOR
	choice
		prompt "MOTIONSENSOR Type"
		config MOTIONSENSOR_IMC20690
			bool "IMC20690"
			depends on !HI3559AV100
	endchoice
endif
```

## reference/hal/screen/Kconfig
```kconfig
#
# For a description of the syntax of this configuration file,
# see Documentation/kbuild/kconfig-language.txt.
#

#comment "Screen Select"

menuconfig SCREEN
	bool "SCREEN support"
	depends on !(DASHCAM && NONESCREEN)

	if SCREEN
	choice
		prompt "SCREEN Type"
		config SCREEN_ST7789
			bool "ST7789"
			depends on (HI3556AV100 || HI3519AV100 || HI3559V200 || HI3556V200) && DEMB
			help
				A Small Screen use RGB Parallel Transmission
		config SCREEN_OTA5182
			bool "OTA5182"
			depends on (HI3559AV100 && DEMB)
			help
				A Small Screen use RGB Parallel Transmission
		config SCREEN_ST7796S_RGB16BIT
			bool "ST7796S_RGB16BIT"
			depends on (HI3556AV100 && REFB_ACTIONCAM) || (HI3559V200 || HI3556V200)
			help
				A Small Screen use RGB Parallel Transmission
		config SCREEN_ILI8961
			bool "ILI8961"
			depends on HI3518EV300 && REFB_DASHCAM
			help
				A Small Screen use RGB Parallel Transmission
	    config SCREEN_OTA7290B
			bool "OTA7290B"
			depends on (HI3556AV100 || HI3559V200 || HI3556V200) && (DASHCAM || SAMPLECAM)
			help
				A Small Screen usemipi Transmission
	endchoice
	config VERTICAL_SCREEN
			bool "Vertical Screen"
endif
```

## reference/hal/touchpad/Kconfig
```kconfig
#
# For a description of the syntax of this configuration file,
# see Documentation/kbuild/kconfig-language.txt.
#
#comment "Device Configuration"

menuconfig TOUCHPAD
	bool "TOUCHPAD support"

if TOUCHPAD
	choice
		prompt "TOUCHPAD Type"
		config TOUCHPAD_FT6356
			bool "ft6356"
			depends on (HI3559AV100)
	    config TOUCHPAD_FT6236
			bool "ft6236"
			depends on (HI3556AV100 || HI3519AV100 || HI3559V200 || HI3556V200)
		config TOUCHPAD_GT911
			bool "gt911"
			depends on (HI3556V200)
	endchoice
	config FLIP_TOUCHPAD
			bool "Flip TouchPad"

endif
```

## reference/hal/watchdog/Kconfig
```kconfig
#
# For a description of the syntax of this configuration file,
# see Documentation/kbuild/kconfig-language.txt.
#
#comment "Device Configuration"

menuconfig WATCHDOG
	bool "WATCHDOG support"
	depends on (HI3559V200)
```

## reference/hal/wifi/Kconfig
```kconfig
#
# For a description of the syntax of this configuration file,
# see Documentation/kbuild/kconfig-language.txt.
#
#comment "Device Configuration"

menuconfig WIFI
	bool "WIFI support"

if WIFI
	choice
		prompt "WIFI Type"
		config WIFI_BCM6255
			bool "bcm6255"
			depends on (HI3559AV100 || HI3556AV100 || HI3519AV100)
		config WIFI_RTL8189
			bool "rtl8189"
			depends on (HI3559V200 || HI3556V200 || HI3518EV300)
		config WIFI_BCM6356S
			bool "bcm6356s"
			depends on (HI3559AV100 && REFB_PANOCAM)
		config WIFI_BCM6214A
			bool "bcm6214a"
			depends on (HI3556AV100 && REFB_ACTIONCAM)
	endchoice
endif
```
