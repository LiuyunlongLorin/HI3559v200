## reference/common/photomng/Kconfig
```kconfig
#
# For a description of the syntax of this configuration file,
# see Documentation/kbuild/kconfig-language.txt.
#

menu "Photo Manager Configuration"
config POST_PROCESS
	bool "POST_PROCESS support"
config EXIF
	bool "EXIF support"
config DNG
	bool "DNG support"
endmenu
```

## reference/common/playback/Kconfig
```kconfig
#
# For a description of the syntax of this configuration file,
# see Documentation/kbuild/kconfig-language.txt.
#

menu "Player Configuration"
config PLAY_BACK
	bool "play back support"
config VOICE_PLAY
	bool "voice play support"
endmenu
```

## reference/common/pm/Kconfig
```kconfig
#
# For a description of the syntax of this configuration file,
# see Documentation/kbuild/kconfig-language.txt.
#

menu "PowerManage Configuration"
config TEMPRATURE_CYCLE
	bool "TEMPRATURE_CYCLE support"
	depends on DASHCAM
endmenu
```
