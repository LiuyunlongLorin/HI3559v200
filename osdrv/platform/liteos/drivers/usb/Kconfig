## osdrv/platform/liteos/drivers/usb/Kconfig
```kconfig
config LOSCFG_DRIVERS_USB
    bool "Enable USB"
    default y
    depends on LOSCFG_DRIVERS
    help
      Answer Y to enable LiteOS support usb.

config LOSCFG_DRIVERS_USB_HOST_DRIVER
    bool "Enable USB HCD"
    default y
    depends on LOSCFG_DRIVERS_USB && LOSCFG_DRIVERS
    help
      Answer Y to enable LiteOS to support usb host controller driver.

choice
    depends on LOSCFG_DRIVERS_USB_HOST_DRIVER
    prompt "USB HCD"
    default y
    help
      Enable EHCI for USB 2.0.
      Enable XHCI for USB 3.0

config LOSCFG_DRIVERS_USB_HOST_EHCI
    bool "Enable EHCI HCD (USB 2.0)"
    depends on LOSCFG_DRIVERS_USB

config LOSCFG_DRIVERS_USB_HOST_XHCI
    bool "Enable XHCI HCD (USB 3.0)"
    depends on LOSCFG_DRIVERS_USB

config LOSCFG_DRIVERS_USB_HOST_XHCI_FOR_PORT2
    bool "Enable XHCI HCD For Port2 (USB 2.0)"
    depends on LOSCFG_DRIVERS_USB && LOSCFG_PLATFORM_HI3556AV100

endchoice

config LOSCFG_DRIVERS_USB_DEVICE_CLASS_DRIVERS
    bool "Enable USB Device Class Drivers"
    default y
    depends on LOSCFG_DRIVERS_USB && LOSCFG_DRIVERS && LOSCFG_DRIVERS_USB_HOST_DRIVER
    help
      Answer Y to enable LiteOS to support usb device class drivers.

menu "USB Device Class Drivers"
    depends on LOSCFG_DRIVERS_USB_DEVICE_CLASS_DRIVERS
config LOSCFG_DRIVERS_USB_MASS_STORAGE
    bool "Enable USB Mass Storage Support"
    default y
    depends on LOSCFG_DRIVERS_USB_DEVICE_CLASS_DRIVERS && LOSCFG_FS_VFS
    help
      Say Y here if you want to connect USB mass storage devices to your system's USB port.

config LOSCFG_DRIVERS_USB_4G_MODEM
    bool "Enable USB 4G Modem Support"
    default y
    depends on LOSCFG_DRIVERS_USB_DEVICE_CLASS_DRIVERS && LOSCFG_NET_LWIP_SACK
    help
      Say Y here if you want to connect USB 4G devices to your system's USB port.

config LOSCFG_DRIVERS_USB_SERIAL
    bool "Enable USB Serial Converter Support"
    default y
    depends on LOSCFG_DRIVERS_USB_DEVICE_CLASS_DRIVERS
    help
      Say Y here if you want to connect USB serial devices to your system's USB port.

config LOSCFG_DRIVERS_USB_ETHERNET
    bool "Enable USB Ethernet Support"
    depends on LOSCFG_NET_LWIP_SACK && LOSCFG_DRIVERS_USB_DEVICE_CLASS_DRIVERS
    help
      Say Y here if you want to connect USB ethernet devices to your system's USB port.

config LOSCFG_DRIVERS_USB_WIRELESS
    bool "Enable USB Wireless Device Support"
    depends on LOSCFG_NET_LWIP_SACK && LOSCFG_DRIVERS_USB_DEVICE_CLASS_DRIVERS
    help
      Say Y here if you want to connect usb-wifi devices to your system's USB port.

endmenu

config LOSCFG_DRIVERS_USB_DWC_DRIVER
    bool "Enable USB DWC Controller"
    default y
    depends on LOSCFG_DRIVERS_USB && LOSCFG_DRIVERS
    help
      Answer Y to enable LiteOS to support device controller driver.

choice
    depends on LOSCFG_DRIVERS_USB_DWC_DRIVER
    prompt "DWC Controller"
    default LOSCFG_DRIVERS_USB2_DEVICE_CONTROLLER
    help
      This selects the usb(ehci/xhci) family usb device.
      Say Y to enable usb2.0 or usb3.0 controller driver.

config LOSCFG_DRIVERS_USB2_DEVICE_CONTROLLER
    bool "Enable USB2.0 Device Controller"

config LOSCFG_DRIVERS_USB3_DEVICE_CONTROLLER
    bool "Enable USB3.0 Device Controller"

config LOSCFG_DRIVERS_USB3_DEVICE_CONTROLLER_FOR_PORT2
    bool "Enable USB2.0 Device Controller For Port2"
    depends on LOSCFG_PLATFORM_HI3556AV100

endchoice

config LOSCFG_DRIVERS_USB_GADGET
    bool "Enable USB Gadget Support"
    default y
    depends on LOSCFG_DRIVERS_USB && LOSCFG_DRIVERS && LOSCFG_DRIVERS_USB_DWC_DRIVER
    help
      Answer Y to enable LiteOS to support usb peripheral devices.
      Enable this configuration option if you want to run LiteOS inside a USB peripheral device.

menu "USB Gadget Drivers"
depends on LOSCFG_DRIVERS_USB_GADGET

config LOSCFG_DRIVERS_USB_MASS_STORAGE_GADGET
    bool "Enable USB Mass Storage Gadget"
    depends on LOSCFG_FS_VFS

config LOSCFG_DRIVERS_USB_UVC_GADGET
    bool "Enable USB Video Class Gadget"
    depends on LOSCFG_DRIVERS_USB_GADGET

config LOSCFG_DRIVERS_USB_UAC_GADGET
    bool "Enable USB Audio Class Gadget"
    depends on LOSCFG_DRIVERS_USB_GADGET

config LOSCFG_DRIVERS_USB_CAMERA_GADGET
    bool "Enable USB Camera Class Gadget"
    depends on LOSCFG_DRIVERS_USB_GADGET

config LOSCFG_DRIVERS_USB_DFU_GADGET
    bool "Enable USB Dfu Gadget"
    depends on LOSCFG_DRIVERS_USB_GADGET

config LOSCFG_DRIVERS_USB_SERIAL_GADGET
    bool "Enable USB Serial Gadget"
    depends on LOSCFG_DRIVERS_USB_GADGET && LOSCFG_DRIVERS_UART && LOSCFG_SHELL

config LOSCFG_DRIVERS_USB_ETHERNET_GADGET
    bool "Enable USB Ethernet Gadget"
    depends on LOSCFG_DRIVERS_USB_GADGET && LOSCFG_NET_LWIP_SACK

config LOSCFG_DRIVERS_USB_ETH_SER_GADGET
    bool "Enable USB Ethernet & Serial Gadget"
    depends on LOSCFG_DRIVERS_USB_GADGET && LOSCFG_DRIVERS_UART && LOSCFG_SHELL && LOSCFG_NET_LWIP_SACK

endmenu

if LOSCFG_DRIVERS_USB_GADGET
config LOSCFG_DRIVERS_USB_COMPOSITE_GADGET
    bool
    default y
endif
```

## osdrv/platform/liteos/drivers/video/Kconfig
```kconfig
config LOSCFG_DRIVERS_VIDEO
    bool "Enable Video"
    default y
    depends on LOSCFG_DRIVERS
    help
        Answer Y to enable LiteOS support video driver.
```

## osdrv/platform/liteos/fs/fat/Kconfig
```kconfig
config LOSCFG_FS_FAT
    bool "Enable FAT"
    default y
    depends on LOSCFG_FS_VFS
    help
      Answer Y to enable LiteOS support fat filesystem.

config LOSCFG_FS_FAT_CACHE
    bool "Enable FAT Cache"
    default y
    depends on LOSCFG_FS_FAT
    help
      Answer Y to enable LiteOS fat filesystem support cache.

config LOSCFG_FS_FAT_CHINESE
    bool "Enable Chinese"
    default y
    depends on LOSCFG_FS_FAT
    help
      Answer Y to enable LiteOS fat filesystem support Chinese.

config LOSCFG_FS_FAT_VIRTUAL_PARTITION
    bool "Enabel Virtual Partition"
    default n
    depends on LOSCFG_FS_FAT

config LOSCFG_FS_FAT_FSCK
    bool "Enabel FAT FSCK"
    default y
    depends on LOSCFG_FS_FAT

config LOSCFG_FS_FAT_VOLUMES
    int
    depends on LOSCFG_FS_FAT
    default 32 if LOSCFG_PLATFORM_HI3731
    default 16
```

## osdrv/platform/liteos/fs/jffs2/Kconfig
```kconfig
config LOSCFG_FS_JFFS
    bool "Enable JFFS2"
    default y
    depends on LOSCFG_FS_VFS
    help
      Answer Y to enable LiteOS support jffs2 filesystem.
```

## osdrv/platform/liteos/fs/nfs/Kconfig
```kconfig
config LOSCFG_FS_NFS
    bool "Enable NFS"
    default y
    depends on LOSCFG_FS_VFS
    depends on LOSCFG_NET_LWIP_SACK
    depends on LOSCFG_DEBUG_VERSION
    help
      Answer Y to enable LiteOS support nfs filesystem.
```

## osdrv/platform/liteos/fs/proc/Kconfig
```kconfig
config LOSCFG_FS_PROC
    bool "Enable PROC"
    default y
    depends on LOSCFG_FS_VFS && LOSCFG_DEBUG_VERSION
    help
      Answer Y to enable LiteOS support proc filesystem.
```

## osdrv/platform/liteos/fs/ramfs/Kconfig
```kconfig
config LOSCFG_FS_RAMFS
    bool "Enable RAMFS"
    default y
    depends on LOSCFG_FS_VFS && LOSCFG_DEBUG_VERSION
    help
      Answer Y to enable LiteOS support ramfs filesystem.
```

## osdrv/platform/liteos/fs/romfs/Kconfig
```kconfig
config LOSCFG_FS_ROMFS
	bool "Enable ROMFS"
	default y
	depends on LOSCFG_FS_VFS
        help
	  Answer Y to enable LiteOS support romfs filesystem.
```

## osdrv/platform/liteos/fs/vfs/Kconfig
```kconfig
config LOSCFG_FS_VFS
    bool "Enable VFS"
    default y

    help
      Answer Y to enable LiteOS support virtual filesystem.
```

## osdrv/platform/liteos/fs/yaffs2/Kconfig
```kconfig
config LOSCFG_FS_YAFFS
    bool "Enable YAFFS2"
    default y
    depends on LOSCFG_FS_VFS
    help
      Answer Y to enable LiteOS support yaffs2 filesystem.

#config LOSCFG_FS_YAFFS_CACHE
#   bool "Enable YAFFS2 Cache"
#   default y
#   depends on LOSCFG_FS_YAFFS
#   help
#     Answer y to support for yaffs2 cache.
```

## osdrv/platform/liteos/kernel/Kconfig
```kconfig
menu "Kernel"
config LOSCFG_KERNEL_LITEKERNEL
    bool "Enable Lite Kernel"
    default y
    help
      This option will enable lite kernel of LiteOS. This is a basic feature,
      so you should say Y here.

config LOSCFG_KERNEL_MEM_TLSF
    bool "Enable mem tlsf"
    default n
    depends on  LOSCFG_KERNEL_LITEKERNEL
    help
      This option will change mem type as tlsf

config LOSCFG_KERNEL_MEM_SLAB
    bool "Enable mem slab"
    default n
    depends on LOSCFG_KERNEL_MEM_TLSF
    help
      This option will change mem type as slab + tlsf

config LOSCFG_KERNEL_MEM_SPEC
    bool "Enable mem spec"
    default n
    depends on LOSCFG_KERNEL_MEM_TLSF
    help
      This option will change mem type as spec + tlsf

config LOSCFG_KERNEL_EXTKERNEL
    bool "Enable Extend Kernel"
    default y
    depends on LOSCFG_KERNEL_LITEKERNEL
    help
      This option will enable extend Kernel of LiteOS.  Extend kernel include
      cppsupport, cpup, dynload, runstop and scatter. You can select one or some
      of them.

config LOSCFG_KERNEL_CPPSUPPORT
    bool "C++ Support"
    default y
    depends on LOSCFG_KERNEL_EXTKERNEL
    help
      If you wish to build LiteOS with support for C++.

config LOSCFG_AARCH64_FPU
    bool "Enable FPU Support"
    default n
    depends on LOSCFG_KERNEL_EXTKERNEL && LOSCFG_ARCH_CORTEX_A53_AARCH64
    help
       Enable this option will support float point

config LOSCFG_KERNEL_MPU
   bool "Enable MPU Support"
   default n
   depends on LOSCFG_KERNEL_EXTKERNEL
   help
     Enable this option only when the processor has a Memory Protection Unit

config LOSCFG_KERNEL_CPUP
    bool "Enable Cpup"
    default y
    depends on LOSCFG_KERNEL_EXTKERNEL
    help
      If you wish to build LiteOS with support for cpup.

config LOSCFG_CPUP_INCLUDE_IRQ
    bool "Enable Cpup include irq"
    default y
    depends on LOSCFG_KERNEL_CPUP
    help
      If you wish to include irq usage for cpup.

config LOSCFG_KERNEL_DYNLOAD
    bool "Enable Dynamic Load Feature"
    default y
    depends on LOSCFG_KERNEL_EXTKERNEL
    help
      If you wish to build LiteOS with support for dynamic load.

config LOSCFG_KERNEL_RUNSTOP
    bool "Enable Run stop Feature"
    default y
    depends on LOSCFG_KERNEL_EXTKERNEL
    help
      If you wish to build LiteOS with support for run-stop.

config LOSCFG_KERNEL_SCATTER
    bool "Enable Scatter Feature"
    default y
    depends on LOSCFG_KERNEL_EXTKERNEL
    help
      If you wish to build LiteOS with support for scatter.

config LOSCFG_KERNEL_TICKLESS
    bool "Enable Tickless Feature"
    default y
    depends on LOSCFG_KERNEL_EXTKERNEL
    help
      If you wish to build LiteOS with support for tickless.
endmenu
```

## osdrv/platform/liteos/lib/Kconfig
```kconfig
menu "Lib"
choice
    prompt "Enable Libc"
    default LOSCFG_LIB_LIBC
    help
      Enable mini libc only for litekernel.
      Enable full libc for full code.
config LOSCFG_LIB_LIBC
    bool "Enable Full Libc"


config LOSCFG_LIB_LIBCMINI
    bool "Enable Mini Libc"

endchoice

config LOSCFG_LIB_LIBM
    bool "Enable Libm"
    default y
    depends on  LOSCFG_LIB_LIBC
    help
      Answer Y to enable LiteOS support math library.

config LOSCFG_LIB_ZLIB
    bool "Enable Zlib"
    default y
    depends on LOSCFG_LIB_LIBC && LOSCFG_LIB_LIBM
    help
      Answer Y to enable LiteOS support compress file library.
endmenu
```

## osdrv/platform/liteos/net/Kconfig
```kconfig
menu "Net"
#config LOSCFG_NET_LWIP
#   bool "Enable Lwip"
#   default y

#   help
#     extend kernel include runstop, dynload, scatter and cppsupport.
#     It can support all or some.

config LOSCFG_NET_LWIP_SACK
    bool "Enable Lwipsack"
    default y

    help
      Answer Y to enable LiteOS support lwip.

#config LOSCFG_NET_MAC
#   bool "Enable Mac"
#   default y

#   help
#     If you wish to build LiteOS with support for dynamic load.

config LOSCFG_NET_WPA
    bool "Enable Wpa"
    default y
    depends on LOSCFG_NET_LWIP_SACK
    help
      Answer Y to enable LiteOS support wpa.

endmenu
```

## osdrv/platform/liteos/net/telnet/Kconfig
```kconfig
config LOSCFG_NET_TELNET
    bool "Enable Telnet"
    default y
    depends on LOSCFG_NET_LWIP_SACK && LOSCFG_SHELL && LOSCFG_DEBUG_VERSION
    help
      Answer Y to enable LiteOS support telnet tool.
```

## osdrv/platform/liteos/shell/Kconfig
```kconfig
config LOSCFG_SHELL
    bool "Enable Shell"
    default y
    depends on LOSCFG_DEBUG_VERSION
    help
      Answer Y to enable LiteOS support shell cmd.

config LOSCFG_SHELL_LK
    bool "Enable Shell lk"
    default y
    depends on LOSCFG_DEBUG_VERSION && LOSCFG_SHELL
    help
      Answer Y to enable LiteOS support shell lk.

config LOSCFG_SHELL_DMESG
    bool "Enable Shell dmesg"
    default n
    depends on LOSCFG_DEBUG_VERSION && LOSCFG_SHELL
    help
      Answer Y to enable LiteOS support shell dmesg.

config LOSCFG_SHELL_EXCINFO
    bool "Enable Shell excInfo"
    default n
    depends on LOSCFG_DEBUG_VERSION && LOSCFG_SHELL
    help
      Answer Y to enable LiteOS support shell excInfo.
```

## osdrv/platform/liteos/tools/iperf-2.0.5/Kconfig
```kconfig
config LOSCFG_TOOLS_IPERF
    bool "Enable Iperf-2.0.5"
    default y
    depends on LOSCFG_DEBUG_VERSION && LOSCFG_SHELL
    help
      Answer Y to enable LiteOS support iperf tool.
```
