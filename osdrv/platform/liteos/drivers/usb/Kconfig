## osdrv/platform/liteos/tools/menuconfig/extra/Configs/Config.in
```kconfig
#
# For a description of the syntax of this configuration file,
# see extra/config/Kconfig-language.txt
#
mainmenu "Huawei LiteOS Configuration"

menu "Compiler"
choice
    prompt "LiteOS_Compiler_Type"
    default LOSCFG_COMPILER_LITEOS
    help
      Enable arm-himix100 or aarch64-himix100 or arm-none compiler.

config LOSCFG_COMPILER_LITEOS_32
    bool "arm-liteos-eabi"
    depends on LOSCFG_PLATFORM_HI3731 || LOSCFG_PLATFORM_HI3911 || LOSCFG_PLATFORM_HIM5V100
config LOSCFG_COMPILER_HIMIX100_32
    bool "arm-himix100-linux"
config LOSCFG_COMPILER_HIMIX200_32
    bool "arm-himix200-linux"
config LOSCFG_COMPILER_HIMIX100_64
    bool "aarch64-himix100-linux"
config LOSCFG_COMPILER_CORTEX_M7
    bool "arm-none-eabi"

endchoice
endmenu


menu "Platform"
choice

    prompt "Board"
    default LOSCFG_PLATFORM_HI3516A
    help
      IPC has several chips:
      hi3516a
      hi3518e
      hi3519
      hi3519v101
      hi3559
      hi3911
      him5v100
      hi3516cv300
      hi3559av100es
      hi3559av100
      hi3556av100
      hi3519av100
      hi3516cv500
      hi3516ev200
      hi3516dv300
      hi3556v200
      hi3559v200

config LOSCFG_PLATFORM_HI3516A
    bool "hi3516a"

config LOSCFG_PLATFORM_HI3518EV200
    bool "hi3518ev200"

config LOSCFG_PLATFORM_HI3519
    bool "hi3519"

config LOSCFG_PLATFORM_HI3519V101
    bool "hi3519v101"

config LOSCFG_PLATFORM_HI3559
    bool "hi3559"

config LOSCFG_PLATFORM_HI3911
    bool "hi3911"

config LOSCFG_PLATFORM_HIM5V100
    bool "him5v100"

config LOSCFG_PLATFORM_HI3516CV300
    bool "hi3516cv300"

config LOSCFG_PLATFORM_HI3731
    bool "hi3731"

config LOSCFG_PLATFORM_HI3559AV100ES
    bool "hi3559av100es"

config LOSCFG_PLATFORM_HI3559AV100
    bool "hi3559av100"

config LOSCFG_PLATFORM_HI3556AV100
    bool "hi3556av100"

config LOSCFG_PLATFORM_HI3519AV100
    bool "hi3519av100"

config LOSCFG_PLATFORM_HI3516CV500
    bool "hi3516cv500"

config LOSCFG_PLATFORM_HI3516EV200
    bool "hi3516ev200"

config LOSCFG_PLATFORM_HI3516DV300
    bool "hi3516dv300"

config LOSCFG_PLATFORM_HI3556V200
    bool "hi3556v200"

config LOSCFG_PLATFORM_HI3559V200
    bool "hi3559v200"

endchoice

choice

    prompt "CPU"
    default LOSCFG_ARCH_CORTEX_A7
    help
      arm926
      cortex m7
      cortex a7
      cortex a17
      cortex a53 aarch32
      cortex a53 aarch64

config LOSCFG_ARCH_ARM926
   bool "arm926"
   depends on LOSCFG_PLATFORM_HI3518EV200 || LOSCFG_PLATFORM_HI3731 || LOSCFG_PLATFORM_HI3516CV300 || LOSCFG_PLATFORM_HIM5V100 || LOSCFG_PLATFORM_HI3911

config LOSCFG_ARCH_CORTEX_M7
   bool "cortex-m7"
   depends on LOSCFG_PLATFORM_HI3559AV100 || LOSCFG_PLATFORM_HI3559AV100ES

config LOSCFG_ARCH_CORTEX_A7
   bool "cortex-a7"
   depends on LOSCFG_PLATFORM_HI3516A || LOSCFG_PLATFORM_HI3559 || LOSCFG_PLATFORM_HI3519 || LOSCFG_PLATFORM_HI3519V101 || LOSCFG_PLATFORM_HI3516CV500 || LOSCFG_PLATFORM_HI3516DV300 || LOSCFG_PLATFORM_HI3556V200 || LOSCFG_PLATFORM_HI3559V200 || LOSCFG_PLATFORM_HI3516EV200 

config LOSCFG_ARCH_CORTEX_A17
   bool "cortex-a17"
   depends on LOSCFG_PLATFORM_HI3559 || LOSCFG_PLATFORM_HI3519 || LOSCFG_PLATFORM_HI3519V101

config LOSCFG_ARCH_CORTEX_A53_AARCH32
   bool "cortex-a53_aarch32"
   depends on LOSCFG_PLATFORM_HI3556AV100 || LOSCFG_PLATFORM_HI3519AV100 || LOSCFG_PLATFORM_HI3559AV100 || LOSCFG_PLATFORM_HI3559AV100ES

config LOSCFG_ARCH_CORTEX_A53_AARCH64
   bool "cortex-a53_aarch64"
   depends on LOSCFG_PLATFORM_HI3559AV100 || LOSCFG_PLATFORM_HI3559AV100ES
endchoice
config LOSCFG_PLATFORM_HISI_AMP
  bool "    Enable Hisilicon AMP Solution"
  default y
  depends on (LOSCFG_PLATFORM_HI3556AV100 || LOSCFG_PLATFORM_HI3519AV100 || LOSCFG_PLATFORM_HI3559AV100  || LOSCFG_PLATFORM_HI3516CV500 || LOSCFG_PLATFORM_HI3516DV300 || LOSCFG_PLATFORM_HI3556V200 || LOSCFG_PLATFORM_HI3559V200 || LOSCFG_PLATFORM_HI3516EV200)
endmenu


######################### config options of kernel #####################
source "../../kernel/Kconfig"
######################### config options of lib ########################
source "../../lib/Kconfig"
######################### config options of compatibility ##############
menu "Compat"
source "../../compat/cmsis/Kconfig"
source "../../compat/posix/Kconfig"
source "../../compat/linux/Kconfig"
endmenu

######################### config options of framework ##################
#source "../../frameworks/m2mcomm/Kconfig"

######################## config options of filesystem ##################
menu "FileSystem"
source "../../fs/vfs/Kconfig"
source "../../fs/fat/Kconfig"
source "../../fs/ramfs/Kconfig"
source "../../fs/romfs/Kconfig"
source "../../fs/yaffs2/Kconfig"
source "../../fs/nfs/Kconfig"
source "../../fs/proc/Kconfig"
source "../../fs/jffs2/Kconfig"
endmenu

######################## config options of net ############################
source "../../net/Kconfig"

######################## config options of debug ########################
menu "Debug"
config LOSCFG_COMPILE_DEBUG
    bool "Enable GCC -g Option"
    default n

    help
      Answer Y to add -g option in gcc command. But the LiteOS size will be much larger.

config LOSCFG_PLATFORM_ADAPT
    bool "Enable Os_adapt"
    default y

    help
      Answer Y to add os_adapt.c to LiteOS.
config LOSCFG_COREDUMP
    bool "Enable Coredump"
    default n

    help
      Answer Y to enable Coredump for LiteOS.

config COREDUMP_COMPRESS_MEM_SIZE
    int "set the compress-packet size(K)"
    default 64
    depends on LOSCFG_COREDUMP
    help
      Its uint is K and the default size is 64K(Raise the size of compressing the packet of dumpinfo to reduce the time of using,if you have enough memory space.)

config LOSCFG_GDB
    bool "Enable GDB"
    default n

choice
    prompt "GDB Debug"
    depends on LOSCFG_GDB
    default  LOSCFG_GDB_DEBUG

    help
        LOSCFG_GDB_DEBUG
        LOSCFG_GDB_ABNORMAL

config LOSCFG_GDB_DEBUG
    bool "GDB adds breakpoint to debug code"

config LOSCFG_GDB_ABNORMAL
    bool "When it's abnormal , invoking gdb to check backtrace"

endchoice

config LOSCFG_DO_ALIGN
    bool "Enable do align for hi3518e"
    default y
    depends on LOSCFG_PLATFORM_HI3518EV200
    help
      Answer Y to enable do align for hi3518e.

config LOSCFG_THUMB
    bool "Enable Thumb"
    default n

    help
      Answer Y to build thumb version.  This will make LiteOS smaller.
config LOSCFG_PLATFORM_DVFS
    bool "Enable Dvfs"
    default n
    depends on  LOSCFG_COMPAT_LINUX
    help
      Answer Y to enable LiteOS support dynamic voltage and frequency scaling feature for
      low power consumption.

config LOSCFG_DEBUG_VERSION
    bool "Enable a Debug Version"
    default n

    help
      If you do not select this option that means you enable a release version for LiteOS.
      It also means you do not want to use debug modules, like shell,telnet,tftp,iperf,
      ,nfs,ramfs proc and memory check.
      If you select this option that means you enable a debug version for LiteOS.
      That means you want a opposite behaviour compared to release version.


source "../../shell/Kconfig"
config LOSCFG_NET_LWIP_SACK_TFTP
    bool "Enable Tftp"
    default y
    depends on LOSCFG_SHELL && LOSCFG_NET_LWIP_SACK && LOSCFG_DEBUG_VERSION
    help
      Answer Y to enable LiteOS support tftp cmd and tftp tool.
source "../../net/telnet/Kconfig"
source "../../tools/iperf-2.0.5/Kconfig"
source "../../tools/pcap/Kconfig"

config LOSCFG_EXC_INTERACTION
    bool "Enable exc interaction"
    default n
    depends on LOSCFG_SHELL
    help
      Answer Y to enable exception interaction for LiteOS, when the system enter exception, user can also interact with system by shell
      command like readreg, writereg,task,hwi.
config LOSCFG_MEM_MUL_MODULE
    bool "Enable Memory module statistics"
            default y
            depends on LOSCFG_DEBUG_VERSION
            help
              Answer Y to enable LiteOS support memory statistics depend on different module
config LOSCFG_MEM_MUL_POOL
    bool "Enable Memory multi-pool control"
            default y
            depends on LOSCFG_DEBUG_VERSION
            help
              Answer Y to enable LiteOS support memory multi-pool control
config LOSCFG_TASK_STACK_PROTECT
    bool "Enable Stack protect by mmu"
            default y
            depends on LOSCFG_DEBUG_VERSION && LOSCFG_PLATFORM_HI3731
            help
              Answer Y to enable Stack protect use mmu
config LOSCFG_MEM_HEAD_BACKUP
    bool "Enable Node Head Backup"
            default 0
            depends on LOSCFG_DEBUG_VERSION
            help
              Answer Y to enable node head backup
config LOSCFG_MEM_RECORDINFO
    bool "Enable Mem Record"
            default n
            depends on LOSCFG_DEBUG_VERSION
            help
              Answer Y to enable mem record
config LOSCFG_BASE_MEM_NODE_INTEGRITY_CHECK
    bool "Enable integrity check or not "
    default n
    depends on LOSCFG_DEBUG_VERSION
config LOSCFG_BASE_MEM_NODE_SIZE_CHECK
    bool "Enable size check or not"
    default n
    depends on LOSCFG_DEBUG_VERSION
config LOSCFG_SLAB_INFO_STATISTIC
    bool "Enable SLAB Statistic"
    default n
    depends on  LOSCFG_DEBUG_VERSION && LOSCFG_KERNEL_MEM_SLAB

choice
    prompt "Enable Uart"
    default LOSCFG_DRIVERS_UART

    help
      Enable simple uart (without vfs) only for litekernel.
      Enable general uart (with vfs) for full code.
source "../../drivers/uart/Kconfig"
config LOSCFG_PLATFORM_UART_WITHOUT_VFS
    bool "Simple Uart"

endchoice

choice
    prompt "Enable TestSuit or AppInit"
    default  LOSCFG_PLATFORM_OSAPPINIT

    help
      Enable osAppinit or testsuit for LiteOS.
config LOSCFG_PLATFORM_OSAPPINIT
    bool "Enable Appinit"

config LOSCFG_TEST
    bool "Enable TestSuit"

    help
      Answer Y to support Test.
endchoice


config LOSCFG_LLTREPORT
    bool "Enable LLT Report"
    default n
    depends on LOSCFG_FS_VFS

choice
    prompt "Code LLT Report"
    depends on LOSCFG_LLTREPORT
    default  LOSCFG_LLTFS

    help
        LOSCFG_LLTFS
        LOSCFG_LLTSER

config LOSCFG_LLTSER
    bool "Enable Serial Transfer"

config LOSCFG_LLTFS
    bool "Enable FS Transfer"

endchoice

endmenu


######################## config options os drivers ########################
menu "Driver"
config LOSCFG_DRIVERS
    bool "Enable Driver"
    default y

    help
      Answer Y to enable LiteOS support driver.

source "../../drivers/base/Kconfig"
source "../../drivers/cpufreq/Kconfig"
source "../../drivers/devfreq/Kconfig"
source "../../drivers/regulator/Kconfig"
source "../../drivers/gpio/Kconfig"
source "../../drivers/hidmac/Kconfig"
source "../../drivers/hiedmac/Kconfig"

config LOSCFG_DRIVERS_NETDEV
    bool "Enable Net Device"
    default y
    depends on LOSCFG_DRIVERS && LOSCFG_NET_LWIP_SACK
    help
      Answer Y to enable LiteOS support net device.

choice
    depends on LOSCFG_DRIVERS_NETDEV
    prompt "MAC"
    default LOSCFG_DRIVERS_HIGMAC
    help
      Enable higmac for hi3516a hi3519 hi3559a_cortex-a53_aarch64.
      Enable hieth-sf for hi3518ev200 hi3911 and him5v100.
source "../../drivers/hieth-sf/Kconfig"
source "../../drivers/higmac/Kconfig"
endchoice

source "../../drivers/i2c/Kconfig"
source "../../drivers/mem/Kconfig"
source "../../drivers/mmc/Kconfig"


config LOSCFG_DRIVERS_MTD
    bool "Enable MTD"
    default y
    depends on LOSCFG_DRIVERS && LOSCFG_FS_VFS
    help
      Answer Y to enable LiteOS support yaffs and jffs2 multipartion.

source "../../drivers/mtd/nand/Kconfig"
source "../../drivers/mtd/spi_nor/Kconfig"
source "../../drivers/random/Kconfig"
source "../../drivers/rtc/Kconfig"
source "../../drivers/spi/Kconfig"
source "../../drivers/usb/Kconfig"
source "../../drivers/video/Kconfig"

endmenu


menu "Stack Smashing Protector (SSP) Compiler Feature"

choice
    prompt "Enable stack buffer overflow detection"
    default  LOSCFG_CC_NO_STACKPROTECTOR

    --help---
    This option turns on the -fstack-protector GCC feature. This
    feature puts, at the beginning of functions, a canary value on
    the stack just before the return address, and validates
    the value just before actually returning.  Stack based buffer
    overflows (that need to overwrite this return address) now also
    overwrite the canary, which gets detected and the attack is then
    neutralized via a kernel panic.

    This feature requires gcc version 4.2 or above, or a distribution
    gcc with the feature backported. Older versions are automatically
    detected and for those versions, this configuration option is
    ignored. (and a warning is printed during bootup)

config LOSCFG_CC_NO_STACKPROTECTOR
    bool "-fno-stack-protector"


config LOSCFG_CC_STACKPROTECTOR
    bool "-fstack-protector"


config LOSCFG_CC_STACKPROTECTOR_ALL
    bool "-fstack-protector-all"


endchoice

endmenu
```

## osdrv/platform/liteos/tools/pcap/Kconfig
```kconfig
config LOSCFG_NET_PCAP
    bool "Enable Pcap"
    default y
    depends on LOSCFG_NET_LWIP_SACK && LOSCFG_DEBUG_VERSION && LOSCFG_SHELL
    help
      Answer Y to enable LiteOS support pcap.
```

## reference/Kconfig
```kconfig
#
# For a description of the syntax of this configuration file,
# see build/scripts/Documentation/kbuild/kconfig-language.txt.
#

source reference/hal/Kconfig
source reference/common/Kconfig

menu "Scene Configuration"
config SCENEAUTO_SUPPORT
	bool "Sceneauto support"
endmenu

menu "Media Configuration"
	config LDC_SUPPORT
		bool "LDC support"
endmenu

menu "UI Configuration"
	choice
		prompt "LCD UI Source Adapt Type"
		default LCD_UISRC_ADAPT_MANUAL
		config LCD_UISRC_ADAPT_AUTO
			bool "auto"
		config LCD_UISRC_ADAPT_MANUAL
			bool "manual"
	endchoice
	config LCD_UISRC_BASE_WIDTH
	    string "LCD UI source base width"
	    depends on LCD_UISRC_ADAPT_AUTO
    config LCD_UISRC_BASE_HEIGHT
	    string "LCD UI source base height"
	    depends on LCD_UISRC_ADAPT_AUTO
    config LCD_UISRC_DEST_WIDTH
	    string "LCD UI source dest width"
	    depends on LCD_UISRC_ADAPT_AUTO
    config LCD_UISRC_DEST_HEIGHT
	    string "LCD UI source dest height"
	    depends on LCD_UISRC_ADAPT_AUTO

    choice
		prompt "HDMI UI Source Adapt Type"
		default HDMI_UISRC_ADAPT_MANUAL
		config HDMI_UISRC_ADAPT_AUTO
			bool "auto"
		config HDMI_UISRC_ADAPT_MANUAL
			bool "manual"
	endchoice
	config HDMI_UISRC_BASE_WIDTH
	    string "HDMI UI source base width"
	    depends on HDMI_UISRC_ADAPT_AUTO
    config HDMI_UISRC_BASE_HEIGHT
	    string "HDMI UI source base height"
	    depends on HDMI_UISRC_ADAPT_AUTO
    config HDMI_UISRC_DEST_WIDTH
	    string "HDMI UI source dest width"
	    depends on HDMI_UISRC_ADAPT_AUTO
    config HDMI_UISRC_DEST_HEIGHT
	    string "HDMI UI source dest height"
	    depends on HDMI_UISRC_ADAPT_AUTO
endmenu

menu "PARAM Configuration"
config PARAM_DIR_SUFFIX
	string "PARAM DIR SUFFIX"
endmenu
```

## reference/common/Kconfig
```kconfig
#
# For a description of the syntax of this configuration file,
# see build/scripts/Documentation/kbuild/kconfig-language.txt.
#

comment "AppComm Modules Configuration"

source reference/common/filemng/Kconfig
source reference/common/recordmng/Kconfig
source reference/common/photomng/Kconfig
source reference/common/playback/Kconfig
source reference/common/rawcap/Kconfig
source reference/common/system/Kconfig
source reference/common/videodetect/Kconfig
source reference/common/pm/Kconfig
```

## reference/common/filemng/Kconfig
```kconfig
#
# For a description of the syntax of this configuration file,
# see Documentation/kbuild/kconfig-language.txt.
#

#comment "File Manager Configuration"

choice
	prompt "File Management Rule"
	help
		Select File Management Rule

	config DCF
		bool "DCF"
		help
			Design rule for Camera File system
	config DTCF
		bool "DTCF"
		help
			Date-Time rule for Camera File system
endchoice
```
